## boards/shields/owl/Kconfig.shield
```kconfig
# Copyright (c) 2023 Bill Hu
# SPDX-License-Identifier: MIT

config SHIELD_OWL_LEFT
    def_bool $(shields_list_contains,owl_left)

config SHIELD_OWL_RIGHT
    def_bool $(shields_list_contains,owl_right)

config SHIELD_OWL_LITE_LEFT
    def_bool $(shields_list_contains,owl_lite_left)

config SHIELD_OWL_LITE_RIGHT
    def_bool $(shields_list_contains,owl_lite_right)
```

## config/boards/shields/why/Kconfig.shield
```kconfig
# Copyright (c) 2020 Pete Johanson
# SPDX-License-Identifier: MIT

config SHIELD_WHY_LEFT
    def_bool $(shields_list_contains,why_left)

config SHIELD_WHY_RIGHT
    def_bool $(shields_list_contains,why_right)
```
